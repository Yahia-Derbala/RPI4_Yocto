## meta-tech/conf/layer.conf
```bitbake
# We have a conf and classes directory, add to BBPATH
BBPATH .= ":${LAYERDIR}"

# We have recipes-* directories, add to BBFILES
BBFILES += "${LAYERDIR}/recipes-*/*/*.bb \
            ${LAYERDIR}/recipes-*/*/*.bbappend"

BBFILE_COLLECTIONS += "meta-tech"
BBFILE_PATTERN_meta-tech = "^${LAYERDIR}/"
BBFILE_PRIORITY_meta-tech = "6"

LAYERDEPENDS_meta-tech = "core"
LAYERSERIES_COMPAT_meta-tech = "kirkstone"
```
